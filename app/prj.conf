## CMakeLists.txt
```
# SPDX-License-Identifier: Apache-2.0

cmake_minimum_required(VERSION 3.20.0)

find_package(Zephyr REQUIRED HINTS $ENV{ZEPHYR_BASE})
project(ulisp)

target_sources(app PRIVATE src/ulisp.c)
target_include_directories(app PRIVATE src)
```

## Kconfig
```
config UART_NATIVE_WAIT_PTS_READY_ENABLE
	bool
	default y if NATIVE_POSIX

source "Kconfig.zephyr"
```

## prj.conf
```kconfig
CONFIG_SERIAL=y

# segfaults on native_posix without these two
CONFIG_DEBUG=y
CONFIG_DEBUG_OPTIMIZATIONS=y

CONFIG_REQUIRES_FULL_LIBC=y

CONFIG_BT=y
CONFIG_BT_CENTRAL=y
CONFIG_BT_PERIPHERAL=y
```

## src/main.c
```c
#include <zephyr/kernel.h>

int main(void)
{
	printk("Hello World! %s\n", CONFIG_BOARD);
	return 0;
}
```
